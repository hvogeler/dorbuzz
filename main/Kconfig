## main/Kconfig
```kconfig
menu "Dorbuzz"
    config DORBUZ_BUZZ_TOPIC
        string "Subscribe to get buzz requests"
        default "dorbuz/buzz/"
        help
            Topic to get buzz requests. 

    config DORBUZZ_LOG_TOPIC
        string "Log Topic"
        default "log/door/dev/dorbuzz/"
        help
            Log topic. device-id and severity added dynamically

    config DORBUZZ_BUZZER_SECONDS
        int "Buzzer Seconds"
        default 4
        help
            Duration of buzzer in seconds.

    config DORBUZZ_DISPLAY_ON_SECONDS
        int "Display on Seconds"
        default 60
        help
            Seconds the display stays on after button press.

endmenu
```
